## Kconfig
```kconfig
# menuconfig TLV493D
#     bool "TLV493D magnetic sensor"
#     depends on I2C
#   # select I2C 
#     help
#       Enable TLV493D magnetic sensor.


menuconfig TLV493D
    bool "Infineon TLV493D 3D Magnetic Sensor"
    depends on I2C
    help
      Enable support for the Infineon TLV493D 3D Magnetic Sensor.

if TLV493D

config TLV493D_POLL_RATE_MS
    int "Polling rate (ms)"
    depends on TLV493D
    default 100
    range 10 1000
    help
      Defines the interval (in milliseconds) for polling TLV493D sensor data.

# module = TLV493D
# module-str = TLV493D
# source = "${ZEPHYR_BASE}/subsys/logging/Kconfig.template.log_config"

endif #TLV493D
```

## dts/bindings/infineon,tlv493d.yaml
```yaml
description: Infineon TLV493D 3D magnetic sensor driver

compatible: "infineon,tlv493d"

# include: i2c-device.yaml
include: base.yaml

properties:
  reg:
    type: array
    required: true
    description: I2C address of the sensor
  
  # polling-interval-ms:
  #   type: int
  #   default: 10
  #   description: Polling interval in milliseconds
```
